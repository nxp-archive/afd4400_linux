## Documentation/devicetree/bindings/clock/d4400-clock.txt
```
* Clock bindings for Freescale D4400

Required properties:
- compatible: Should be "fsl,d4400-ccm"
- reg: Address and length of the register set
- interrupts: Should contain CCM interrupt
- #clock-cells: Should be <1>

The clock consumer should specify the desired clock by having the clock
ID in its "clocks" phandle cell.  The following is a full list of d4400
clocks and IDs.

	Clock		ID
	-----------------
	dummy		0
	osc1_dev	1
	osc2_sgmii	2
	sys_pll		3
	ddr_pll		4
	tbgen_pll	5
	tbgen_half_pll	6
	ref		7
	sys		8
	arm		9
	per		10
	vsp_clk		11
	ram		12
	sys_bus		13
	ahb		14
	ip		15
	gpc		16
	uart1_serial	17
	uart1_per	18
	uart2_serial	19
	uart2_per	20
	uart3_serial	21
	uart3_per	22
	uart4_serial	23
	uart4_per	24
	weim_sel	25
	weim_clk	26
	div_pll_sys	27
	etsec_rtc	28
	sync_ref	29
	async_ckil	30
	sync_ckil	31
	ecspi1_sel	32
	ecspi1_clk	33
	ecspi2_sel	34
	ecspi2_clk	35
	ecspi3_sel	36
	ecspi3_clk	37
	ecspi4_sel	38
	ecspi4_clk	39
	ecspi5_sel	40
	ecspi5_clk	41
	ecspi6_sel	42
	ecspi6_clk	43
	ecspi7_sel	44
	ecspi_clk	45
	ecspi8_sel	46
	ecspi8_clk	47
	vspa_dp_sel	48
	vspa_dp_clk	49
	ccm_at		50
	trace		51
	ddr_pll_by	52
	mmdc_sel	53
	mmdc_clk	54
	epit_ipg        55
	epit_per        56
	uart1_ipg	57
	uart1_pen	58
	uart2_ipg	59
	uart2_pen	60
        uart3_ipg	61
	uart3_pen	62
	uart4_ipg	63
	uart4_pen	64
	i2c1_per	65
	i2c2_per	66
	i2c3_per	67
	i2c4_per	68
	i2c5_per	69
	i2c6_per	70
	i2c7_per	71
	i2c8_per	72
	i2c9_per	73
	i2c10_per	74
	i2c11_per	75
	clk_max		76

Examples:
clks: ccm@014000 {
	compatible = "fsl,d4400-ccm";
	reg = <0x14000 0x4000>;
	#clock-cells = <1>;
};

uart1: serial@06c000 {
	compatible = "fsl,d4400-uart";
	reg = <0x6C000 0x4000>;
	interrupts = <0 0 0x04>;
	clocks = <&clks 57>, <&clks 18>;
	clock-names = "ipg", "per";
	status = "disabled";
};
```

## arch/arm/configs/d4400_evb_defconfig
```kconfig
CONFIG_EXPERIMENTAL=y
# CONFIG_LOCALVERSION_AUTO is not set
CONFIG_SYSVIPC=y
CONFIG_NO_HZ=y
CONFIG_HIGH_RES_TIMERS=y
CONFIG_LOG_BUF_SHIFT=18
CONFIG_CGROUPS=y
CONFIG_RELAY=y
CONFIG_BLK_DEV_INITRD=y
CONFIG_EXPERT=y
CONFIG_PERF_EVENTS=y
CONFIG_DEBUG_PERF_USE_VMALLOC=y
# CONFIG_SLUB_DEBUG is not set
# CONFIG_COMPAT_BRK is not set
CONFIG_MODULES=y
CONFIG_MODULE_UNLOAD=y
CONFIG_MODVERSIONS=y
CONFIG_MODULE_SRCVERSION_ALL=y
# CONFIG_BLK_DEV_BSG is not set
CONFIG_ARCH_D4400=y
CONFIG_SOC_D4400=y
CONFIG_SRC_D4400=y
CONFIG_HAVE_D4400_GPC=y
CONFIG_VMSPLIT_2G=y
CONFIG_PREEMPT_RT_FULL=y
CONFIG_AEABI=y
# CONFIG_OABI_COMPAT is not set
CONFIG_CMDLINE="noinitrd console=ttymxc0,115200"
CONFIG_VFP=y
CONFIG_NEON=y
CONFIG_BINFMT_MISC=m
CONFIG_PM_DEBUG=y
CONFIG_PM_TEST_SUSPEND=y
CONFIG_NET=y
CONFIG_PACKET=y
CONFIG_UNIX=y
CONFIG_INET=y
CONFIG_IP_PNP=y
CONFIG_IP_PNP_DHCP=y
# CONFIG_INET_XFRM_MODE_TRANSPORT is not set
# CONFIG_INET_XFRM_MODE_TUNNEL is not set
# CONFIG_INET_XFRM_MODE_BEET is not set
# CONFIG_INET_LRO is not set
# CONFIG_IPV6 is not set
CONFIG_BRIDGE=y
CONFIG_VLAN_8021Q=y
CONFIG_DNS_RESOLVER=y
# CONFIG_WIRELESS is not set
CONFIG_DEVTMPFS=y
CONFIG_DEVTMPFS_MOUNT=y
# CONFIG_STANDALONE is not set
CONFIG_CONNECTOR=y
CONFIG_MTD=y
CONFIG_MTD_CMDLINE_PARTS=y
CONFIG_MTD_CHAR=y
CONFIG_MTD_BLOCK=y
CONFIG_MTD_CFI=y
CONFIG_MTD_JEDECPROBE=y
CONFIG_MTD_CFI_INTELEXT=y
CONFIG_MTD_CFI_AMDSTD=y
CONFIG_MTD_CFI_STAA=y
CONFIG_MTD_PHYSMAP_OF=y
CONFIG_MTD_NAND=y
CONFIG_PROC_DEVICETREE=y
CONFIG_BLK_DEV_LOOP=y
CONFIG_BLK_DEV_RAM=y
CONFIG_BLK_DEV_RAM_SIZE=65536
CONFIG_LANDSHARK=y
CONFIG_AD9368=y
CONFIG_XCVR=y
CONFIG_EEPROM_AT24=y
CONFIG_EEPROM_AT25=y
CONFIG_NETDEVICES=y
# CONFIG_NET_VENDOR_BROADCOM is not set
# CONFIG_NET_VENDOR_FARADAY is not set
CONFIG_GIANFAR=y
# CONFIG_NET_VENDOR_INTEL is not set
# CONFIG_NET_VENDOR_MARVELL is not set
# CONFIG_NET_VENDOR_MICREL is not set
# CONFIG_NET_VENDOR_MICROCHIP is not set
# CONFIG_NET_VENDOR_NATSEMI is not set
# CONFIG_NET_VENDOR_SEEQ is not set
CONFIG_SMC91X=y
CONFIG_SMC911X=y
CONFIG_SMSC911X=y
# CONFIG_NET_VENDOR_STMICRO is not set
CONFIG_VITESSE_PHY=y
# CONFIG_WLAN is not set
CONFIG_RF_CPRI=y
CONFIG_RF_SFP=y
CONFIG_INPUT_POLLDEV=y
# CONFIG_INPUT_MOUSEDEV is not set
CONFIG_INPUT_EVDEV=y
CONFIG_INPUT_EVBUG=m
# CONFIG_INPUT_KEYBOARD is not set
# CONFIG_INPUT_MOUSE is not set
CONFIG_INPUT_MISC=y
# CONFIG_SERIO is not set
CONFIG_VT_HW_CONSOLE_BINDING=y
# CONFIG_LEGACY_PTYS is not set
# CONFIG_DEVKMEM is not set
CONFIG_SERIAL_IMX=y
CONFIG_SERIAL_IMX_CONSOLE=y
CONFIG_HW_RANDOM=y
CONFIG_I2C=y
# CONFIG_I2C_COMPAT is not set
CONFIG_I2C_CHARDEV=y
CONFIG_I2C_MUX=y
CONFIG_I2C_MUX_PCA954x=y
# CONFIG_I2C_HELPER_AUTO is not set
CONFIG_I2C_ALGOBIT=m
CONFIG_I2C_ALGOPCA=m
CONFIG_I2C_IMX=y
CONFIG_SPI=y
CONFIG_SPI_IMX=y
CONFIG_GPIO_SYSFS=y
# CONFIG_HWMON is not set
CONFIG_WATCHDOG=y
CONFIG_IMX2_WDT=y
CONFIG_REGULATOR=y
CONFIG_REGULATOR_FIXED_VOLTAGE=y
# CONFIG_HID is not set
# CONFIG_USB_SUPPORT is not set
CONFIG_RTC_CLASS=y
CONFIG_RTC_INTF_DEV_UIE_EMUL=y
CONFIG_DMADEVICES=y
CONFIG_COMMON_CLK_DEBUG=y
# CONFIG_IOMMU_SUPPORT is not set
CONFIG_GCR_DEV=y
CONFIG_SERDES_D4400=y

CONFIG_TBGEN=y
CONFIG_JESD=y
CONFIG_DFE_JESD204=y
CONFIG_EXT2_FS=y
CONFIG_EXT2_FS_XATTR=y
CONFIG_EXT2_FS_POSIX_ACL=y
CONFIG_EXT2_FS_SECURITY=y
CONFIG_QUOTA=y
CONFIG_QUOTA_NETLINK_INTERFACE=y
# CONFIG_PRINT_QUOTA_WARNING is not set
CONFIG_AUTOFS4_FS=y
CONFIG_FUSE_FS=y
CONFIG_TMPFS=y
CONFIG_CONFIGFS_FS=m
CONFIG_JFFS2_FS=y
CONFIG_NFS_FS=y
CONFIG_ROOT_NFS=y
CONFIG_NLS=y
CONFIG_NLS_DEFAULT="cp437"
CONFIG_NLS_CODEPAGE_437=y
CONFIG_NLS_ASCII=y
CONFIG_NLS_ISO8859_1=y
CONFIG_NLS_ISO8859_15=m
CONFIG_NLS_UTF8=y
CONFIG_MAGIC_SYSRQ=y
CONFIG_DEBUG_SECTION_MISMATCH=y
# CONFIG_SCHED_DEBUG is not set
# CONFIG_DEBUG_BUGVERBOSE is not set
# CONFIG_FTRACE is not set
# CONFIG_ARM_UNWIND is not set
CONFIG_KEYS=y
CONFIG_SECURITYFS=y
CONFIG_CRYPTO_CRC32C=y
CONFIG_CRYPTO_DEFLATE=y
CONFIG_CRYPTO_LZO=y
# CONFIG_CRYPTO_ANSI_CPRNG is not set
# CONFIG_CRYPTO_HW is not set
CONFIG_CRC_CCITT=m
CONFIG_CRC16=y
CONFIG_CRC_T10DIF=y
CONFIG_CRC_ITU_T=m
CONFIG_CRC7=m
CONFIG_LIBCRC32C=m
```

## arch/arm/mach-d4400/Kconfig
```kconfig
menu "Freescale D4400 support"
	depends on ARCH_D4400

comment "Device tree only"

config HAVE_D4400_GPC
	bool

config SOC_D4400
	bool "D4400 support"
	select ARM_GIC
	select COMMON_CLK
	select PINCTRL
	select PINCTRL_D4400
	select HAVE_D4400_GPC
	select GCR_DEV
	select CPU_V7
	help
	  This enables support for Freescale D4400 processor.

endmenu

config BOARD_EVB
       tristate "EVB board"
       depends on SOC_D4400
       default n
       help
         EVB board support for Freescale D4400 processor

config BOARD_4T4R
       tristate "POC board"
       depends on SOC_D4400
       default n
       help
         4T4R board support for Freescale D4400 processor

config BOARD_4T4RK1
       tristate "POC 4T4RK1 board"
       depends on SOC_D4400
       default n
       help
         4T4RK1 board support for NXP D4400 processor

config  D4400_QSPI_NUMONYX_BUG_WORKAROUND
       tristate "D4400 qspi Numonyx bug workaround"
       depends on SOC_D4400
       depends on (BOARD_4T4R || BOARD_4T4RK1)
       default n
       help
         Work around qspi bug with erase cmd in Numonyx mode

config SERDES_D4400
       tristate "SerDes driver"
       depends on SOC_D4400
       help
       SerDes driver for Freescale D4400 processor
	The SerDes module implements link serialization/deserialization
	functions for high speed serial interfaces from 1.2288 Gbaud to
	9.8304 Gbaud

config SRC_D4400
       tristate "System reset controller driver"
       depends on SOC_D4400
       help
       System reset controller driver  for Freescale D4400 processor
```

## drivers/jesd/Kconfig
```kconfig
#
# jesd204 configuration
#
#
menuconfig JESD
	bool "Jesd drivers"
	depends on HAS_IOMEM
	help
	  dfe configuration for jesd drivers, for now only jesd204 drvier
	  is supported. Any further jesd defined protocol drivers shall be
	  appened in here.
if JESD

config DFE_JESD204
	bool "Jesd204"
	help
	  For jesd204 ip to get enable we need this for the configuration
	  upon this includes the phygasket. Each of the two transport can
	  can accomidate a max of 2 lanes in combination.
	  Transport 1 --> 2 lanes max
	  Transport 2 --> 1 lane max

endif #jesd
```

## drivers/net/cpri/Kconfig
```kconfig
config RF_CPRI
	tristate "CPRI"
	help
	  If you say yes to this option, support will be included
	  for CPRI driver
```

## drivers/net/cpri/finisar/Kconfig
```kconfig
config RF_FINISAR
	tristate "FINISAR"
	help
	  If you say yes to this option, support will be included
	  for FINISAR driver
```

## drivers/net/cpri/sfp/Kconfig
```kconfig
config RF_SFP
	bool "SFP"
	help
	  If you say yes to this option, support will be included
	  for SFP driver
```

## drivers/rf/Kconfig
```kconfig
#
# RF subsystem configuration
#

menuconfig RF
	tristate "RF support"
	depends on HAS_IOMEM
	---help---
	  If you say yes to this option, support will be included
	  for RF subsystem drivers

if RF

source drivers/rf/gcr/Kconfig

endif # RF
```

## drivers/rf/cpri/Kconfig
```kconfig
#
# RF driver configuration
#

menu "CPRI support"
	depends on RF

config RF_CPRI
	bool "CPRI"
	help
	  If you say yes to this option, support will be included
	  for CPRI driver

config RF_SFP
        bool "SFP"
        help
          If you say yes to this option, support will be included
          for SFP driver

endmenu
```

## drivers/rf/gcr/Kconfig
```kconfig
#
# GCR Configuration
#

menuconfig GCR_DEV
	tristate "GCR Configuration support "
	help
	  GCR are genral purpose control registers used to
	  configure dma channels for data transfer to and
	  from VSP with CPRI/JESD.

if GCR_DEV

endif # GCR_DEV
```

## drivers/tbgen/Kconfig
```kconfig
#
# Miscellaneous DD4400-specific timer base generator (TBGEN) device
#
#
menu "TBGEN Device"
	depends on HAS_IOMEM

config TBGEN
	bool "Tbgen"
	help
	  TBGEN DD4400 configuration, shall be the main clock configuration
	  for jesd204 from the 10ms framer clock. This shall be base for the
	  clock generation for the jesd204 and vsp ip's.
	  For tbgen ip to get enable we need this for the configuration of
	  jesd204, and align the timers in reference to 10ms radio frame.

endmenu
```
